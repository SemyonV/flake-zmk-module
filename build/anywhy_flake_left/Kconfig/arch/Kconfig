## build/anywhy_flake_left/Kconfig/arch/Kconfig
```kconfig
# Load Zephyr Arch Kconfig descriptions.
osource "/zmk/zephyr/arch/x86/Kconfig"
osource "/zmk/zephyr/arch/xtensa/Kconfig"
osource "/zmk/zephyr/arch/sparc/Kconfig"
osource "/zmk/zephyr/arch/riscv/Kconfig"
osource "/zmk/zephyr/arch/posix/Kconfig"
osource "/zmk/zephyr/arch/nios2/Kconfig"
osource "/zmk/zephyr/arch/mips/Kconfig"
osource "/zmk/zephyr/arch/arm64/Kconfig"
osource "/zmk/zephyr/arch/arm/Kconfig"
osource "/zmk/zephyr/arch/arc/Kconfig"
```

## build/anywhy_flake_left/Kconfig/boards/Kconfig
```kconfig
# Load Zephyr board Kconfig descriptions.
osource "/zmk/zmk/app/module/boards/nicekeyboards/nice_nano/Kconfig"
osource "/zmk/zmk/app/boards/nicekeyboards/nice_nano/Kconfig"
```

## build/anywhy_flake_left/Kconfig/soc/Kconfig
```kconfig
# Load Zephyr SoC Kconfig descriptions.
osource "/zmk/zephyr/soc/xlnx/zynqmp/Kconfig"
osource "/zmk/zephyr/soc/xlnx/zynq7000/Kconfig"
osource "/zmk/zephyr/soc/xen/Kconfig"
osource "/zmk/zephyr/soc/wch/ch32v/Kconfig"
osource "/zmk/zephyr/soc/ti/simplelink/Kconfig"
osource "/zmk/zephyr/soc/ti/lm3s6965/Kconfig"
osource "/zmk/zephyr/soc/ti/k3/Kconfig"
osource "/zmk/zephyr/soc/telink/tlsr/Kconfig"
osource "/zmk/zephyr/soc/starfive/jh71xx/Kconfig"
osource "/zmk/zephyr/soc/st/stm32/Kconfig"
osource "/zmk/zephyr/soc/snps/qemu_arc/Kconfig"
osource "/zmk/zephyr/soc/snps/nsim/arc_v/Kconfig"
osource "/zmk/zephyr/soc/snps/nsim/arc_classic/Kconfig"
osource "/zmk/zephyr/soc/snps/hsdk4xd/Kconfig"
osource "/zmk/zephyr/soc/snps/hsdk/Kconfig"
osource "/zmk/zephyr/soc/snps/emsk/Kconfig"
osource "/zmk/zephyr/soc/snps/emsdp/Kconfig"
osource "/zmk/zephyr/soc/snps/arc_iot/Kconfig"
osource "/zmk/zephyr/soc/silabs/Kconfig"
osource "/zmk/zephyr/soc/sifive/sifive_freedom/Kconfig"
osource "/zmk/zephyr/soc/sensry/Kconfig"
osource "/zmk/zephyr/soc/rockchip/Kconfig"
osource "/zmk/zephyr/soc/renode/riscv_virtual/Kconfig"
osource "/zmk/zephyr/soc/renode/cortex_r8_virtual/Kconfig"
osource "/zmk/zephyr/soc/renesas/smartbond/Kconfig"
osource "/zmk/zephyr/soc/renesas/rzt2m/Kconfig"
osource "/zmk/zephyr/soc/renesas/rz/Kconfig"
osource "/zmk/zephyr/soc/renesas/rcar/Kconfig"
osource "/zmk/zephyr/soc/renesas/ra/Kconfig"
osource "/zmk/zephyr/soc/realtek/ec/Kconfig"
osource "/zmk/zephyr/soc/raspberrypi/rpi_pico/Kconfig"
osource "/zmk/zephyr/soc/quicklogic/eos_s3/Kconfig"
osource "/zmk/zephyr/soc/qemu/virt_riscv/Kconfig"
osource "/zmk/zephyr/soc/qemu/malta/Kconfig"
osource "/zmk/zephyr/soc/openisa/rv32m1/Kconfig"
osource "/zmk/zephyr/soc/nxp/s32/Kconfig"
osource "/zmk/zephyr/soc/nxp/rw/Kconfig"
osource "/zmk/zephyr/soc/nxp/mcx/Kconfig"
osource "/zmk/zephyr/soc/nxp/lpc/Kconfig"
osource "/zmk/zephyr/soc/nxp/layerscape/Kconfig"
osource "/zmk/zephyr/soc/nxp/kinetis/Kconfig"
osource "/zmk/zephyr/soc/nxp/imxrt/Kconfig"
osource "/zmk/zephyr/soc/nxp/imx/Kconfig"
osource "/zmk/zephyr/soc/nuvoton/numicro/Kconfig"
osource "/zmk/zephyr/soc/nuvoton/numaker/Kconfig"
osource "/zmk/zephyr/soc/nuvoton/npcx/Kconfig"
osource "/zmk/zephyr/soc/nuvoton/npcm/Kconfig"
osource "/zmk/zephyr/soc/nordic/Kconfig"
osource "/zmk/zephyr/soc/neorv32/Kconfig"
osource "/zmk/zephyr/soc/native/inf_clock/Kconfig"
osource "/zmk/zephyr/soc/microchip/miv/Kconfig"
osource "/zmk/zephyr/soc/microchip/mec/Kconfig"
osource "/zmk/zephyr/soc/mediatek/mt8xxx/Kconfig"
osource "/zmk/zephyr/soc/lowrisc/opentitan/Kconfig"
osource "/zmk/zephyr/soc/litex/litex_vexriscv/Kconfig"
osource "/zmk/zephyr/soc/ite/ec/Kconfig"
osource "/zmk/zephyr/soc/intel/raptor_lake/Kconfig"
osource "/zmk/zephyr/soc/intel/lakemont/Kconfig"
osource "/zmk/zephyr/soc/intel/intel_socfpga_std/Kconfig"
osource "/zmk/zephyr/soc/intel/intel_socfpga/Kconfig"
osource "/zmk/zephyr/soc/intel/intel_niosv/Kconfig"
osource "/zmk/zephyr/soc/intel/intel_ish/Kconfig"
osource "/zmk/zephyr/soc/intel/intel_adsp/Kconfig"
osource "/zmk/zephyr/soc/intel/elkhart_lake/Kconfig"
osource "/zmk/zephyr/soc/intel/atom/Kconfig"
osource "/zmk/zephyr/soc/intel/apollo_lake/Kconfig"
osource "/zmk/zephyr/soc/intel/alder_lake/Kconfig"
osource "/zmk/zephyr/soc/infineon/cat3/Kconfig"
osource "/zmk/zephyr/soc/infineon/cat1b/Kconfig"
osource "/zmk/zephyr/soc/infineon/cat1a/Kconfig"
osource "/zmk/zephyr/soc/gd/gd32/Kconfig"
osource "/zmk/zephyr/soc/gaisler/leon3/Kconfig"
osource "/zmk/zephyr/soc/gaisler/gr716a/Kconfig"
osource "/zmk/zephyr/soc/espressif/Kconfig"
osource "/zmk/zephyr/soc/ene/kb1200/Kconfig"
osource "/zmk/zephyr/soc/efinix/sapphire/Kconfig"
osource "/zmk/zephyr/soc/cdns/xtensa_sample_controller/Kconfig"
osource "/zmk/zephyr/soc/cdns/sample_controller32/Kconfig"
osource "/zmk/zephyr/soc/cdns/dc233c/Kconfig"
osource "/zmk/zephyr/soc/brcm/bcmvk/Kconfig"
osource "/zmk/zephyr/soc/brcm/bcm2712/Kconfig"
osource "/zmk/zephyr/soc/brcm/bcm2711/Kconfig"
osource "/zmk/zephyr/soc/atmel/sam0/Kconfig"
osource "/zmk/zephyr/soc/atmel/sam/Kconfig"
osource "/zmk/zephyr/soc/aspeed/Kconfig"
osource "/zmk/zephyr/soc/arm/Kconfig"
osource "/zmk/zephyr/soc/arm/beetle/Kconfig"
osource "/zmk/zephyr/soc/antmicro/myra/Kconfig"
osource "/zmk/zephyr/soc/andestech/Kconfig"
osource "/zmk/zephyr/soc/amd/acp_6_0/Kconfig"
osource "/zmk/zephyr/soc/ambiq/Kconfig"
osource "/zmk/zephyr/soc/altr/zephyr_nios2f/Kconfig"
osource "/zmk/zephyr/soc/altr/qemu_nios2/Kconfig"
osource "/zmk/zephyr/soc/adi/max32/Kconfig"
```

## build/anywhy_flake_right/Kconfig/boards/Kconfig.defconfig
```kconfig
# Load Zephyr board defconfig descriptions.
osource "/zmk/zmk/app/module/boards/nicekeyboards/nice_nano/Kconfig.defconfig"
osource "/zmk/zmk/app/boards/nicekeyboards/nice_nano/Kconfig.defconfig"
```

## build/anywhy_flake_right/Kconfig/boards/Kconfig.nice_nano
```kconfig
# Load board Kconfig descriptions.
osource "/zmk/zmk/app/module/boards/nicekeyboards/nice_nano/Kconfig.nice_nano"
osource "/zmk/zmk/app/boards/nicekeyboards/nice_nano/Kconfig.nice_nano"
```

## build/anywhy_flake_right/Kconfig/boards/Kconfig.sysbuild
```kconfig
# Load Sysbuild board Kconfig descriptions.
osource "/zmk/zmk/app/module/boards/nicekeyboards/nice_nano/Kconfig.sysbuild"
osource "/zmk/zmk/app/boards/nicekeyboards/nice_nano/Kconfig.sysbuild"
```

## build/settings_reset/Kconfig/Kconfig.modules
```kconfig
config ZEPHYR_ZMK_HELPERS_MODULE
	bool
	default y
menu "zmk-auto-layer (/zmk/zmk-auto-layer)"
osource "/zmk/zmk-auto-layer/Kconfig"
config ZEPHYR_ZMK_AUTO_LAYER_MODULE
	bool
	default y
endmenu
menu "zmk-leader-key (/zmk/zmk-leader-key)"
osource "/zmk/zmk-leader-key/Kconfig"
config ZEPHYR_ZMK_LEADER_KEY_MODULE
	bool
	default y
endmenu
menu "zmk-tri-state (/zmk/zmk-tri-state)"
osource "/zmk/zmk-tri-state/Kconfig"
config ZEPHYR_ZMK_TRI_STATE_MODULE
	bool
	default y
endmenu
menu "zmk-unicode (/zmk/zmk-unicode)"
osource "/zmk/zmk-unicode/Kconfig"
config ZEPHYR_ZMK_UNICODE_MODULE
	bool
	default y
endmenu
config ZEPHYR_HAL_STM32_MODULE
	bool
	default y

config ZEPHYR_HAL_STM32_MODULE_BLOBS
	bool
menu "lvgl (/zmk/modules/lib/gui/lvgl)"
osource "/zmk/modules/lib/gui/lvgl/zephyr/Kconfig"
config ZEPHYR_LVGL_MODULE
	bool
	default y
endmenu
config ZEPHYR_ZMK_STUDIO_MESSAGES_MODULE
	bool
	default y
menu "canopennode (/zmk/modules/lib/canopennode)"
osource "$(ZEPHYR_CANOPENNODE_KCONFIG)"
config ZEPHYR_CANOPENNODE_MODULE
	bool
	default y
endmenu
menu "chre (/zmk/modules/lib/chre)"
osource "/zmk/modules/lib/chre/platform/zephyr/Kconfig"
config ZEPHYR_CHRE_MODULE
	bool
	default y
endmenu
menu "lz4 (/zmk/modules/lib/lz4)"
osource "$(ZEPHYR_LZ4_KCONFIG)"
config ZEPHYR_LZ4_MODULE
	bool
	default y
endmenu
menu "nanopb (/zmk/modules/lib/nanopb)"
osource "$(ZEPHYR_NANOPB_KCONFIG)"
config ZEPHYR_NANOPB_MODULE
	bool
	default y
endmenu
config ZEPHYR_PSA_ARCH_TESTS_MODULE
	bool
	default y
menu "sof (/zmk/modules/audio/sof)"
osource "/zmk/modules/audio/sof/zephyr/Kconfig"
config ZEPHYR_SOF_MODULE
	bool
	default y
endmenu
config ZEPHYR_TF_M_TESTS_MODULE
	bool
	default y
menu "tflite-micro (/zmk/optional/modules/lib/tflite-micro)"
osource "$(ZEPHYR_TFLITE_MICRO_KCONFIG)"
config ZEPHYR_TFLITE_MICRO_MODULE
	bool
	default y
endmenu
menu "thrift (/zmk/optional/modules/lib/thrift)"
osource "$(ZEPHYR_THRIFT_KCONFIG)"
config ZEPHYR_THRIFT_MODULE
	bool
	default y
endmenu
menu "lang-rust (/zmk/modules/lang/rust)"
osource "/zmk/modules/lang/rust/Kconfig"
config ZEPHYR_LANG_RUST_MODULE
	bool
	default y
endmenu
menu "zscilib (/zmk/modules/lib/zscilib)"
osource "/zmk/modules/lib/zscilib/Kconfig.zscilib"
config ZEPHYR_ZSCILIB_MODULE
	bool
	default y
endmenu
menu "acpica (/zmk/modules/lib/acpica)"
osource "$(ZEPHYR_ACPICA_KCONFIG)"
config ZEPHYR_ACPICA_MODULE
	bool
	default y
endmenu
menu "cmsis (/zmk/modules/hal/cmsis)"
osource "$(ZEPHYR_CMSIS_KCONFIG)"
config ZEPHYR_CMSIS_MODULE
	bool
	default y
endmenu
menu "cmsis-dsp (/zmk/modules/lib/cmsis-dsp)"
osource "$(ZEPHYR_CMSIS_DSP_KCONFIG)"
config ZEPHYR_CMSIS_DSP_MODULE
	bool
	default y
endmenu
menu "cmsis-nn (/zmk/modules/lib/cmsis-nn)"
osource "$(ZEPHYR_CMSIS_NN_KCONFIG)"
config ZEPHYR_CMSIS_NN_MODULE
	bool
	default y
endmenu
menu "fatfs (/zmk/modules/fs/fatfs)"
osource "$(ZEPHYR_FATFS_KCONFIG)"
config ZEPHYR_FATFS_MODULE
	bool
	default y
endmenu
config ZEPHYR_ADI_MODULE
	bool
	default y
menu "hal_ambiq (/zmk/modules/hal/ambiq)"
osource "$(ZEPHYR_HAL_AMBIQ_KCONFIG)"
config ZEPHYR_HAL_AMBIQ_MODULE
	bool
	default y
endmenu
config ZEPHYR_ATMEL_MODULE
	bool
	default y
menu "hal_espressif (/zmk/modules/hal/espressif)"
osource "/zmk/modules/hal/espressif/zephyr/Kconfig"
config ZEPHYR_HAL_ESPRESSIF_MODULE
	bool
	default y

config ZEPHYR_HAL_ESPRESSIF_MODULE_BLOBS
	bool
endmenu
menu "hal_ethos_u (/zmk/modules/hal/ethos_u)"
osource "$(ZEPHYR_HAL_ETHOS_U_KCONFIG)"
config ZEPHYR_HAL_ETHOS_U_MODULE
	bool
	default y
endmenu
menu "hal_gigadevice (/zmk/modules/hal/gigadevice)"
osource "$(ZEPHYR_HAL_GIGADEVICE_KCONFIG)"
config ZEPHYR_HAL_GIGADEVICE_MODULE
	bool
	default y
endmenu
menu "hal_intel (/zmk/modules/hal/intel)"
osource "/zmk/modules/hal/intel/zephyr/Kconfig"
config ZEPHYR_HAL_INTEL_MODULE
	bool
	default y
endmenu
menu "hal_nordic (/zmk/modules/hal/nordic)"
osource "$(ZEPHYR_HAL_NORDIC_KCONFIG)"
config ZEPHYR_HAL_NORDIC_MODULE
	bool
	default y

config ZEPHYR_HAL_NORDIC_MODULE_BLOBS
	bool
endmenu
config ZEPHYR_NUVOTON_MODULE
	bool
	default y
config ZEPHYR_QUICKLOGIC_MODULE
	bool
	default y
config ZEPHYR_HAL_RENESAS_MODULE
	bool
	default y

config ZEPHYR_HAL_RENESAS_MODULE_BLOBS
	bool
menu "hal_rpi_pico (/zmk/modules/hal/rpi_pico)"
osource "$(ZEPHYR_HAL_RPI_PICO_KCONFIG)"
config ZEPHYR_HAL_RPI_PICO_MODULE
	bool
	default y
endmenu
menu "hal_silabs (/zmk/modules/hal/silabs)"
osource "$(ZEPHYR_HAL_SILABS_KCONFIG)"
config ZEPHYR_HAL_SILABS_MODULE
	bool
	default y

config ZEPHYR_HAL_SILABS_MODULE_BLOBS
	bool
endmenu
menu "hal_tdk (/zmk/modules/hal/tdk)"
osource "$(ZEPHYR_HAL_TDK_KCONFIG)"
config ZEPHYR_HAL_TDK_MODULE
	bool
	default y
endmenu
menu "hal_telink (/zmk/modules/hal/telink)"
osource "/zmk/modules/hal/telink/Kconfig"
config ZEPHYR_HAL_TELINK_MODULE
	bool
	default y
endmenu
menu "hal_wch (/zmk/modules/hal/wch)"
osource "$(ZEPHYR_HAL_WCH_KCONFIG)"
config ZEPHYR_HAL_WCH_MODULE
	bool
	default y
endmenu
config ZEPHYR_HAL_WURTHELEKTRONIK_MODULE
	bool
	default y
menu "hostap (/zmk/modules/lib/hostap)"
osource "$(ZEPHYR_HOSTAP_KCONFIG)"
config ZEPHYR_HOSTAP_MODULE
	bool
	default y
endmenu
menu "liblc3 (/zmk/modules/lib/liblc3)"
osource "$(ZEPHYR_LIBLC3_KCONFIG)"
config ZEPHYR_LIBLC3_MODULE
	bool
	default y
endmenu
config ZEPHYR_LIBMCTP_MODULE
	bool
	default y
config ZEPHYR_LIBMETAL_MODULE
	bool
	default y
menu "littlefs (/zmk/modules/fs/littlefs)"
osource "$(ZEPHYR_LITTLEFS_KCONFIG)"
config ZEPHYR_LITTLEFS_MODULE
	bool
	default y
endmenu
menu "mbedtls (/zmk/modules/crypto/mbedtls)"
osource "$(ZEPHYR_MBEDTLS_KCONFIG)"
config ZEPHYR_MBEDTLS_MODULE
	bool
	default y
endmenu
config ZEPHYR_MIPI_SYS_T_MODULE
	bool
	default y
menu "nrf_wifi (/zmk/modules/lib/nrf_wifi)"
osource "$(ZEPHYR_NRF_WIFI_KCONFIG)"
config ZEPHYR_NRF_WIFI_MODULE
	bool
	default y

config ZEPHYR_NRF_WIFI_MODULE_BLOBS
	bool
endmenu
config ZEPHYR_OPEN_AMP_MODULE
	bool
	default y
menu "percepio (/zmk/modules/debug/percepio)"
osource "/zmk/modules/debug/percepio/zephyr/Kconfig"
config ZEPHYR_PERCEPIO_MODULE
	bool
	default y
endmenu
menu "picolibc (/zmk/modules/lib/picolibc)"
osource "/zmk/modules/lib/picolibc/zephyr/Kconfig"
config ZEPHYR_PICOLIBC_MODULE
	bool
	default y
endmenu
menu "segger (/zmk/modules/debug/segger)"
osource "$(ZEPHYR_SEGGER_KCONFIG)"
config ZEPHYR_SEGGER_MODULE
	bool
	default y
endmenu
config ZEPHYR_TINYCRYPT_MODULE
	bool
	default y
menu "trusted-firmware-a (/zmk/modules/tee/tf-a/trusted-firmware-a)"
osource "$(ZEPHYR_TRUSTED_FIRMWARE_A_KCONFIG)"
config ZEPHYR_TRUSTED_FIRMWARE_A_MODULE
	bool
	default y
endmenu
menu "uoscore-uedhoc (/zmk/modules/lib/uoscore-uedhoc)"
osource "$(ZEPHYR_UOSCORE_UEDHOC_KCONFIG)"
config ZEPHYR_UOSCORE_UEDHOC_MODULE
	bool
	default y
endmenu
menu "zcbor (/zmk/modules/lib/zcbor)"
osource "$(ZEPHYR_ZCBOR_KCONFIG)"
config ZEPHYR_ZCBOR_MODULE
	bool
	default y
endmenu
menu "module (/zmk/zmk/app/module)"
osource "/zmk/zmk/app/module/Kconfig"
config ZEPHYR_MODULE_MODULE
	bool
	default y
endmenu
config ZEPHYR_KEYMAP_MODULE_MODULE
	bool
	default y
config ZEPHYR_NRF_HW_MODELS_MODULE
	bool
	default y
```

## build/settings_reset/Kconfig/Kconfig.shield
```kconfig
osource "/zmk/boards/shields/*/Kconfig.shield"
osource "/zmk/zmk/app/module/boards/shields/*/Kconfig.shield"
osource "/zmk/zmk/app/boards/shields/*/Kconfig.shield"
```

## build/settings_reset/Kconfig/Kconfig.shield.defconfig
```kconfig
osource "/zmk/boards/shields/*/Kconfig.defconfig"
osource "/zmk/zmk/app/module/boards/shields/*/Kconfig.defconfig"
osource "/zmk/zmk/app/boards/shields/*/Kconfig.defconfig"
```

## config/west.yml
```yaml
manifest:
  remotes:
    - name: urob
      url-base: https://github.com/urob

    - name: zmkfirmware
      url-base: https://github.com/zmkfirmware

  projects:
    - name: zmk
      remote: zmkfirmware
      revision: main
      import: app/west.yml

    - name: zmk-helpers
      remote: urob
      revision: main

    - name: zmk-auto-layer
      remote: urob
      revision: dfa7c695ffde41ef8064245453595d50e198ae1d # main (4/19/2026)
    - name: zmk-leader-key
      remote: urob
      revision: 749f7faf65cc4105c82fbe64cfaa7e09a8a63605 # main (4/19/2026)
    - name: zmk-tri-state
      remote: urob
      revision: 2007896c6d5bfb519e8babccf8633841c5647d8b # main (4/19/2026)
    - name: zmk-unicode
      remote: urob
      revision: 1a6dbc797a46c4a61c3c71a7a9d013a5d5aee49e # main (4/19/2026)

  self:
    path: config
```
